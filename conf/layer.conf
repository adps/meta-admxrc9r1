## conf/layer.conf
```bitbake
# We have a conf and classes directory, add to BBPATH
BBPATH .= ":${LAYERDIR}"

# We have a recipes-* directories, add to BBFILES
BBFILES += "${LAYERDIR}/recipes-*/*/*.bb \
	${LAYERDIR}/recipes-*/*/*.bbappend"

BBFILE_COLLECTIONS += "admxrc9r1"
BBFILE_PATTERN_admxrc9r1 = "^${LAYERDIR}/"
BBFILE_PRIORITY_admxrc9r1 = "6"

LAYERSERIES_COMPAT_admxrc9r1 = "thud"
```
